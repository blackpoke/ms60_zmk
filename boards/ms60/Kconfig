## boards/ms60/Kconfig
```kconfig
# Copyright (c) 2026 The ZMK Contributors
# SPDX-License-Identifier: MIT

config BOARD_ENABLE_DCDC
	bool "Enable DCDC mode"
	select SOC_DCDC_NRF52X
	default y
	depends on BOARD_MS60
```

## boards/ms60/Kconfig.ms60
```kconfig
# Copyright (c) 2026 The ZMK Contributors
# SPDX-License-Identifier: MIT

config BOARD_MS60
	select SOC_NRF52840_QIAA
	select ZMK_BOARD_COMPAT if BOARD_MS60_NRF52840_ZMK
	imply RETAINED_MEM if BOARD_MS60_NRF52840_ZMK
	imply RETENTION if BOARD_MS60_NRF52840_ZMK
	imply RETENTION_BOOT_MODE if BOARD_MS60_NRF52840_ZMK
```

## boards/ms60/board.yml
```yaml
board:
  name: ms60
  full_name: Mystery 60
  vendor: mystery
  socs:
    - name: nrf52840
      variants:
        - name: zmk
```

## boards/ms60/ms60_nrf52840_defconfig
```kconfig
# Enable MPU
CONFIG_ARM_MPU=y
CONFIG_PINCTRL=y

# Configure NFC pins as GPIOs (P0.09 and P0.10)
CONFIG_NFCT_PINS_AS_GPIOS=y

# Enable both USB and BLE
CONFIG_ZMK_USB=y
CONFIG_ZMK_BLE=y

# Enable GPIO
CONFIG_GPIO=y

# Clock control (Internal RC oscillator)
CONFIG_CLOCK_CONTROL_NRF=y
CONFIG_CLOCK_CONTROL_NRF_K32SRC_RC=y
CONFIG_ZMK_BLE_EXPERIMENTAL_CONN=y
CONFIG_BT_CTLR_TX_PWR_PLUS_8=y
CONFIG_BT_CTLR_PHY_2M=n

# Consumer report
CONFIG_ZMK_HID_CONSUMER_REPORT_USAGES_BASIC=y

# Enable writing to flash
CONFIG_USE_DT_CODE_PARTITION=y
CONFIG_MPU_ALLOW_FLASH_WRITE=y
CONFIG_NVS=y
CONFIG_SETTINGS_NVS=y
CONFIG_FLASH=y
CONFIG_FLASH_PAGE_LAYOUT=y
CONFIG_FLASH_MAP=y
CONFIG_BUILD_OUTPUT_UF2=y
CONFIG_ZMK_HID_REPORT_TYPE_NKRO=y

# Polling rate (1ms)
CONFIG_USB_HID_POLL_INTERVAL_MS=1

# Debounce
CONFIG_ZMK_KSCAN_DEBOUNCE_PRESS_MS=5
CONFIG_ZMK_KSCAN_DEBOUNCE_RELEASE_MS=5
CONFIG_ZMK_KSCAN_EVENT_QUEUE_SIZE=30

# WS2812 Underglow
CONFIG_ZMK_RGB_UNDERGLOW=y
CONFIG_WS2812_STRIP=y
CONFIG_ZMK_RGB_UNDERGLOW_ON_START=y
CONFIG_ZMK_RGB_UNDERGLOW_BRT_START=20
CONFIG_ZMK_RGB_UNDERGLOW_HUE_START=160
CONFIG_ZMK_RGB_UNDERGLOW_EFF_START=3
CONFIG_ZMK_RGB_UNDERGLOW_EXT_POWER=n
CONFIG_ZMK_RGB_UNDERGLOW_AUTO_OFF_IDLE=y

# Sleep
CONFIG_ZMK_SLEEP=y
CONFIG_ZMK_IDLE_TIMEOUT=120000
CONFIG_ZMK_IDLE_SLEEP_TIMEOUT=1200000

# ZMK Studio
CONFIG_ZMK_STUDIO=y
CONFIG_ZMK_STUDIO_LOCKING=n
```
